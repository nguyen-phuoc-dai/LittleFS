## components/littlefs/Kconfig
```kconfig
menu "LittleFS Configuration"

    config LFS_MAX_PARTITIONS
        int "Maximum Number of Partitions"
        default 3
        range 1 10
        help
            Define maximum number of partitions that can be mounted.

    config LFS_PAGE_SIZE
        int "LittleFS logical page size"
        default 256
        range 256 1024
        help
            Logical page size of LittleFS partition, in bytes. Must be multiple
            of flash page size (which is usually 256 bytes).
            Larger page sizes reduce overhead when storing large files, and
            improve filesystem performance when reading large files.
            Smaller page sizes reduce overhead when storing small (< page size)
            files.
endmenu
```
